/*
 * dsh-stm32-toolchain - ESP-01S (ESP8266) Wi-Fi bridge for STM32 UART flashing
 *
 * Two TCP servers (always available once the ESP has a network):
 *   CTRL_PORT (3333) - line based control: BOOT0 / NRST / reset pulses / status / wifi
 *   PIPE_PORT (3334) - raw bidirectional pipe to UART0 = the STM32 USART (115200 8N1)
 *
 * Wi-Fi credentials, in priority order:
 *   1. EEPROM        - saved by the provisioning page (survives reboot AND a normal reflash)
 *   2. wifi_creds.h  - generated by the plugin ("生成固件" bakes SSID/password in)
 *   3. provisioning  - neither works: start an AP + config page (network setup, not a fallback LAN)
 *
 * Wiring (ESP-01S is 3.3 V only):
 *   ESP TX  -> STM32 USART RX (PA10 on F411 / F407 USART1)
 *   ESP RX  -> STM32 USART TX (PA9)
 *   GND     -> common ground
 *   3V3     -> 3V3 rail (>= 300 mA, 100 uF close to the module)
 *   GPIO2   -> STM32 BOOT0
 *   GPIO0   -> STM32 NRST   (10k pull-up mandatory: GPIO0 must be HIGH at boot)
 *
 * The ESP never prints to UART0 except transparent payload: debug text goes to the
 * CTRL socket, so the pipe stays byte clean for AN3155.
 */

#include <stdarg.h>
#include <DNSServer.h>
#include <EEPROM.h>
#if defined(ESP32)
  #include <WiFi.h>
  #include <WebServer.h>
#else
  #include <ESP8266WiFi.h>
  #include <ESP8266WebServer.h>
#endif

#if __has_include("wifi_creds.h")
#include "wifi_creds.h"          /* written by the plugin: #define WIFI_SSID / WIFI_PASS */
#endif
#ifndef WIFI_SSID
#define WIFI_SSID ""
#endif
#ifndef WIFI_PASS
#define WIFI_PASS ""
#endif

/* ------------------------- fixed configuration ------------------------- */
#define AP_SSID          "STM32-ESP01S"   /* provisioning access point */
#define AP_PASS          "stm32flash"
#define STA_TIMEOUT_MS   15000

/* Board selection. ESP-12E / NodeMCU is the recommended carrier: its own USB and
 * 3.3 V regulator make it far more tolerant than a bare ESP-01S, and D1/D2 carry no
 * boot strap, so driving the STM32 from them cannot put the ESP in flash mode. */
#ifndef BOARD_NODEMCU
#define BOARD_NODEMCU    1                /* 1 = ESP-12E/NodeMCU, 0 = ESP-01S */
#endif

#if defined(ESP32)
/* ESP32 DevKit: UART2 talks to the STM32, UART0 stays free for USB debug.
 * GPIO 25/26 carry no boot strap, so driving BOOT0/NRST cannot misfire. */
#define PIN_BOOT0        4                /* D4 -> STM32 BOOT0（实测：D25/D26 孔不通到 MCU） */
#define PIN_NRST         5                /* D5 -> STM32 NRST  */
#define PIN_STM_RX       16               /* GPIO16 = RX2  <- STM32 TX */
#define PIN_STM_TX       17               /* GPIO17 = TX2  -> STM32 RX */
#define STM              Serial2
/* UART0 is free on the ESP32, so boot diagnostics are visible over USB. */
#define DBG(...)         do { Serial.printf(__VA_ARGS__); Serial.flush(); } while (0)
#elif BOARD_NODEMCU
#define PIN_BOOT0        4                /* D2 -> STM32 BOOT0 */
#define PIN_NRST         5                /* D1 -> STM32 NRST  */
#define STM              Serial
#define DBG(...)         do { } while (0)
#else
#define PIN_BOOT0        2                /* GPIO2 -> BOOT0 */
#define PIN_NRST         0                /* GPIO0 -> NRST  */
#define STM              Serial
#define DBG(...)         do { } while (0)
#endif
/* 链路协议：由插件生成固件时写入 wifi_creds.h。stream = 透明管道（主机驱动 AN3155），
 * block = 块级 ACK，spool = 镜像缓存后 ESP 自烧。目前只有 stream 实现。 */
#define LINK_MODE_STREAM 1
#define LINK_MODE_BLOCK  2
#define LINK_MODE_SPOOL  3
#ifndef LINK_MODE
#define LINK_MODE LINK_MODE_STREAM
#endif
#if LINK_MODE == LINK_MODE_BLOCK
#define LINK_NAME "block"
#elif LINK_MODE == LINK_MODE_SPOOL
#define LINK_NAME "spool"
#else
#define LINK_NAME "stream"
#endif

#if LINK_MODE == LINK_MODE_SPOOL
  #include <LittleFS.h>
#endif
#if defined(ESP32)
  #include <esp_system.h>
#endif

#ifndef PIPE_BAUD
#define PIPE_BAUD        115200       /* 生成固件时由插件写入（wifi_creds.h）；也可 -D 覆盖 */
#endif
#define CTRL_PORT        3333
#define PIPE_PORT        3334
#define PULSE_MS_DEFAULT 100
#define BOOT_SETTLE_MS   30           /* BOOT0 必须先稳住，再给复位沿 */
#define RESET_PULSE_MS   200          /* 复位低电平时间 */
#define BOOT_POST_MS     50           /* 释放后等芯片起来 */

#if LINK_MODE == LINK_MODE_SPOOL
static bool s_spoolFsOk = false;   /* LittleFS mounted? spool needs it */
#endif

/* ESP GPIO0 drives NRST but is ALSO the ESP's own flash-mode strap: at power-up the
 * STM32 holds NRST low (its reset circuit), which can make the ESP sample GPIO0 low
 * and boot into UART download mode - completely silent, no AP. Two defences:
 *   1. hardware: put a diode between them (anode NRST, cathode GPIO0) + 10k pull-up
 *      on GPIO0, so the STM32 can never drag GPIO0 down;
 *   2. firmware: once we are running, drive BOOT0 low and pulse NRST so the STM32
 *      re-samples a correct boot mode instead of sitting in the bootloader. */
#define SELF_SYNC_STM32 1

/* How GPIO0 drives NRST:
 *   0 = direct wire (GPIO0 low = reset). Needs a diode so the STM32 cannot drag the
 *       ESP strap low at power-up.
 *   1 = open-collector stage: GPIO0 -> 1k -> base(NPN) or gate(N-MOS), emitter/source
 *       to GND, collector/drain to NRST. GPIO0 high = reset. No shared net, so the
 *       strap hazard disappears and a plain NPN/MOSFET is enough (no diode needed). */
#define NRST_INVERTED 0
/* ---------------------------------------------------------------------- */

struct WifiCreds {
  uint32_t magic;
  char     ssid[33];
  char     pass[65];
};
#define CREDS_MAGIC 0x32534457u   /* "WDS2" */

static WifiCreds s_creds;
static const char *s_wifiSrc = "none";      /* flash | build | ap */
static bool s_provisioning = false;
static int  s_lastStaStatus = 0;            /* wl_status_t of the last failed join */
static char s_triedSsid[33] = "";

WiFiServer ctrlServer(CTRL_PORT);
WiFiServer pipeServer(PIPE_PORT);
WiFiClient ctrlClient;
WiFiClient pipeClient;
#if defined(ESP32)
WebServer web(80);
#else
ESP8266WebServer web(80);
#endif
DNSServer dns;

static uint32_t ctrlCount = 0;
static uint32_t pipeBytesDown = 0;
static uint32_t pipeBytesUp = 0;

/* ------------------------------ helpers ------------------------------- */
static bool credsValid(void)
{
  return s_creds.magic == CREDS_MAGIC && s_creds.ssid[0] != '\0';
}

static void credsLoad(void)
{
  EEPROM.begin(sizeof(WifiCreds));
  EEPROM.get(0, s_creds);
  if (!credsValid()) memset(&s_creds, 0, sizeof(s_creds));
}

static void credsSave(const char *ssid, const char *pass)
{
  memset(&s_creds, 0, sizeof(s_creds));
  s_creds.magic = CREDS_MAGIC;
  strncpy(s_creds.ssid, ssid, sizeof(s_creds.ssid) - 1);
  strncpy(s_creds.pass, pass, sizeof(s_creds.pass) - 1);
  EEPROM.put(0, s_creds);
  EEPROM.commit();
}

static void credsClear(void)
{
  memset(&s_creds, 0, sizeof(s_creds));
  EEPROM.put(0, s_creds);
  EEPROM.commit();
}

/** Returns String: WiFi.SSID() is a temporary, so its c_str() must not outlive the call. */
static String activeSsid(void)
{
  if (s_provisioning) return String(AP_SSID);
  String ssid = WiFi.SSID();
  return ssid.length() > 0 ? ssid : String("none");
}

static String ipString(void)
{
  if (s_provisioning) return WiFi.softAPIP().toString();
  return WiFi.localIP().toString();
}

static int s_pinBoot0 = PIN_BOOT0;
static int s_pinNrst  = PIN_NRST;
static void boot0Set(int level) { digitalWrite(s_pinBoot0, level ? HIGH : LOW); }

/** level 1 = reset released, 0 = reset asserted. */
static void nrstSet(int level)
{
#if NRST_INVERTED
  digitalWrite(s_pinNrst, level ? LOW : HIGH);   /* transistor on = reset asserted */
#else
  digitalWrite(s_pinNrst, level ? HIGH : LOW);
#endif
}

static void nrstPulse(uint32_t ms)
{
  nrstSet(0);
  delay(ms);
  nrstSet(1);
}

static void ctrlPrintf(const char *fmt, ...)
{
  if (!ctrlClient || !ctrlClient.connected()) return;
  char buf[192];
  va_list ap;
  va_start(ap, fmt);
  vsnprintf(buf, sizeof(buf), fmt, ap);
  va_end(ap);
  ctrlClient.print(buf);
}

static void banner(void)
{
  ctrlPrintf("+READY mode=%s src=%s ssid=%s ip=%s boot0=%d nrst=%d baud=%d pipe=%d link=%s\r\n",
             s_provisioning ? "ap" : "sta", s_wifiSrc, activeSsid().c_str(), ipString().c_str(),
             digitalRead(s_pinBoot0), digitalRead(s_pinNrst), PIPE_BAUD, PIPE_PORT, LINK_NAME);
  if (s_provisioning && s_lastStaStatus != 0) {
    ctrlPrintf("+LASTSTA tried=%s status=%d %s\r\n", s_triedSsid, s_lastStaStatus, staReason(s_lastStaStatus));
  }
}

/* ---------------------------- provisioning ---------------------------- */
static void provisioningPage(void)
{
  String ssidArg = web.arg("ssid");
  String html =
    "<!doctype html><meta charset=utf-8><meta name=viewport content='width=device-width,initial-scale=1'>"
    "<title>STM32 无线配网</title>"
    "<body style='font-family:system-ui;max-width:22rem;margin:2rem auto;padding:0 1rem'>"
    "<h2>STM32 无线配网</h2>"
    "<p style='color:#666;font-size:.9rem'>填入这台机器人要连的 Wi-Fi，保存后自动重启连接。</p>"
    "<form method='POST' action='/save'>"
    "<label>Wi-Fi 名称</label><br><input name=ssid value='" + ssidArg + "' style='width:100%;padding:.5rem;margin:.3rem 0 1rem'>"
    "<label>Wi-Fi 密码</label><br><input name=pass type=password style='width:100%;padding:.5rem;margin:.3rem 0 1.2rem'>"
    "<button style='width:100%;padding:.6rem;font-size:1rem'>保存并连接</button></form>"
    "<p style='color:#999;font-size:.8rem;margin-top:1.5rem'>当前来源: " + String(s_wifiSrc) +
    (s_lastStaStatus ? "<br>上次连接 " + String(s_triedSsid) + " 失败: " + String(s_lastStaStatus) + " (" + String(staReason(s_lastStaStatus)) + ")" : "") +
    "</p></body>";
  web.send(200, "text/html; charset=utf-8", html);
}

static void startProvisioning(void)
{
  WiFi.mode(WIFI_AP);
  WiFi.softAP(AP_SSID, AP_PASS);
  dns.setErrorReplyCode(DNSReplyCode::NoError);
  dns.start(53, "*", WiFi.softAPIP());

  web.on("/", provisioningPage);
  web.on("/save", []() {
    String ssid = web.arg("ssid");
    String pass = web.arg("pass");
    if (ssid.length() == 0) {
      web.send(400, "text/plain; charset=utf-8", "SSID 不能为空");
      return;
    }
    credsSave(ssid.c_str(), pass.c_str());
    web.send(200, "text/plain; charset=utf-8", "已保存，正在重启并连接 " + ssid);
    delay(1200);
    ESP.restart();
  });
  web.onNotFound([]() {
    web.sendHeader("Location", "http://192.168.4.1/", true);
    web.send(302, "text/plain", "");
  });
  web.begin();
  s_provisioning = true;
  s_wifiSrc = "ap";
}

/** Plain-language reason, so the provisioning page can tell "5 GHz" from "wrong password". */
static const char *staReason(int status)
{
  switch (status) {
    case 0:  return "idle";
    case 1:  return "no-ssid (2.4GHz? name? in range?)";
    case 3:  return "connected";
    case 4:  return "connect-failed";
    case 5:  return "connection-lost";
    case 6:  return "wrong-password";
    default: return "disconnected";
  }
}

static bool joinWifi(const char *ssid, const char *pass, uint32_t timeoutMs)
{
  if (ssid == NULL || ssid[0] == '\0') return false;
  DBG("[bridge] join: mode(sta)\n");
  WiFi.mode(WIFI_STA);
  DBG("[bridge] join: autoreconnect\n");
  WiFi.setAutoReconnect(true);
  DBG("[bridge] join: begin(%s)\n", ssid);
  WiFi.begin(ssid, pass);
  DBG("[bridge] join: waiting\n");
  strncpy(s_triedSsid, ssid, sizeof(s_triedSsid) - 1);
  uint32_t t0 = millis();
  while (WiFi.status() != WL_CONNECTED && millis() - t0 < timeoutMs) delay(150);
  DBG("[bridge] join: done status=%d\n", (int)WiFi.status());
  s_lastStaStatus = (int)WiFi.status();
  return WiFi.status() == WL_CONNECTED;
}

/* ----------------------------- control -------------------------------- */
static void handleCommand(String line)
{
  line.trim();
  if (line.length() == 0) return;
  ctrlCount++;

  if (line.equalsIgnoreCase("PING")) {
    ctrlPrintf("+PONG %lu\r\n", (unsigned long)millis());
    return;
  }
  if (line.startsWith("BOOT ")) {
    int v = line.substring(5).toInt() ? 1 : 0;
    boot0Set(v);
    ctrlPrintf("+BOOT %d\r\n", v);
    return;
  }
  if (line.startsWith("NRST ")) {
    int v = line.substring(5).toInt() ? 1 : 0;
    nrstSet(v);
    ctrlPrintf("+NRST %d\r\n", v);
    return;
  }
  if (line.startsWith("PULSE")) {
    uint32_t ms = (line.length() > 5) ? (uint32_t)line.substring(6).toInt() : PULSE_MS_DEFAULT;
    if (ms < 20) ms = 20;
    if (ms > 2000) ms = 2000;
    nrstPulse(ms);
    ctrlPrintf("+PULSE %lu\r\n", (unsigned long)ms);
    return;
  }
  if (line.equalsIgnoreCase("BOOTLOADER")) {
    boot0Set(1);
    delay(BOOT_SETTLE_MS);
    nrstPulse(RESET_PULSE_MS);
    delay(BOOT_POST_MS);
    /* Read the pin back: 0 here means the wire to BOOT0 is not actually connected. */
    ctrlPrintf("+BOOTLOADER boot0=%d\r\n", digitalRead(PIN_BOOT0));
    return;
  }
  if (line.equalsIgnoreCase("RUN")) {
    boot0Set(0);
    nrstPulse(PULSE_MS_DEFAULT);
    ctrlPrintf("+RUN\r\n");
    return;
  }
  if (line.equalsIgnoreCase("WIFI")) {
    ctrlPrintf("+WIFI mode=%s src=%s ssid=%s ip=%s rssi=%d haveSaved=%d tried=%s last=%d:%s\r\n",
               s_provisioning ? "ap" : "sta", s_wifiSrc, activeSsid().c_str(), ipString().c_str(),
               s_provisioning ? 0 : WiFi.RSSI(), credsValid() ? 1 : 0,
               s_triedSsid, s_lastStaStatus, staReason(s_lastStaStatus));
    return;
  }
  if (line.equalsIgnoreCase("RESETWIFI")) {
    credsClear();
    ctrlPrintf("+RESETWIFI saved credentials cleared, restarting into provisioning\r\n");
    delay(200);
    ESP.restart();
  }
  if (line.equalsIgnoreCase("STATUS")) {
    ctrlPrintf("+STATUS mode=%s src=%s ssid=%s ip=%s rssi=%d boot0=%d nrst=%d pipe=%s cmds=%lu rx=%lu tx=%lu up=%lu link=%s\r\n",
               s_provisioning ? "ap" : "sta", s_wifiSrc, activeSsid().c_str(), ipString().c_str(),
               s_provisioning ? 0 : WiFi.RSSI(),
               digitalRead(s_pinBoot0), digitalRead(s_pinNrst),
               (pipeClient && pipeClient.connected()) ? "on" : "off",
               (unsigned long)ctrlCount, (unsigned long)pipeBytesDown,
               (unsigned long)pipeBytesUp, (unsigned long)(millis() / 1000), LINK_NAME);
    return;
  }
  if (line.equalsIgnoreCase("REBOOT")) {
    ctrlPrintf("+REBOOT\r\n");
    delay(50);
    ESP.restart();
  }
  if (line.startsWith("PIN ")) {
    /* 通用脚控：PIN <gpio> <0|1|z>，用来现场找出开发板 D 编号对应的真实 GPIO */
    int gpio = -1, level = -1;
    if (sscanf(line.c_str(), "PIN %d %d", &gpio, &level) == 2 && gpio >= 0 && gpio <= 39) {
      if (level < 0 || level > 1) {
        pinMode(gpio, INPUT);
      } else {
        pinMode(gpio, OUTPUT);
        digitalWrite(gpio, level ? HIGH : LOW);
      }
      ctrlPrintf("+PIN %d %d\r\n", gpio, level);
    } else {
      ctrlPrintf("+PIN err\r\n");
    }
    return;
  }
  if (line.startsWith("PULL ")) {
    /* 接线探测：PULL <gpio> <0=下拉|1=上拉>，随后用 IN <gpio> 读；外部上/下拉会压过内部弱上下拉 */
    int gpio = -1, up = -1;
    if (sscanf(line.c_str(), "PULL %d %d", &gpio, &up) == 2 && gpio >= 0 && gpio <= 39) {
      pinMode(gpio, up ? INPUT_PULLUP : INPUT_PULLDOWN);
      ctrlPrintf("+PULL %d %d\r\n", gpio, up);
    } else {
      ctrlPrintf("+PULL err\r\n");
    }
    return;
  }
  if (line.startsWith("IN ")) {
    int gpio = -1;
    if (sscanf(line.c_str(), "IN %d", &gpio) == 1 && gpio >= 0 && gpio <= 39) {
      pinMode(gpio, INPUT);
      ctrlPrintf("+IN %d %d\r\n", gpio, digitalRead(gpio));
    } else {
      ctrlPrintf("+IN err\r\n");
    }
    return;
  }
  if (line.startsWith("PINSET ")) {
    int b = -1, n = -1;
    if (sscanf(line.c_str(), "PINSET %d %d", &b, &n) == 2 && b >= 0 && b <= 39 && n >= 0 && n <= 39 && b != n) {
      pinMode(s_pinBoot0, INPUT);
      pinMode(s_pinNrst, INPUT);
      s_pinBoot0 = b;
      s_pinNrst = n;
  pinMode(s_pinBoot0, OUTPUT);
      pinMode(s_pinNrst, OUTPUT);
      boot0Set(0);
      nrstSet(1);
      ctrlPrintf("+PINSET boot0=%d nrst=%d\r\n", s_pinBoot0, s_pinNrst);
    } else {
      ctrlPrintf("+PINSET err\r\n");
    }
    return;
  }
  if (line.equalsIgnoreCase("PINS")) {
    /* 接线诊断：读回四根线的实际电平（BOOT0/NRST 由我们驱动，rx2 由 STM32 驱动） */
    ctrlPrintf("+PINS boot0=%d nrst=%d rx2=%d tx2=%d\r\n",
               digitalRead(s_pinBoot0), digitalRead(s_pinNrst),
               digitalRead(PIN_STM_RX), digitalRead(PIN_STM_TX));
    return;
  }
  ctrlPrintf("+ERR unknown\r\n");
}

/* ------------------------------- main --------------------------------- */
void setup()
{
#if defined(ESP32)
  Serial.begin(115200);                 /* USB debug: must be up before the first DBG */
#endif
  DBG("\n[bridge] boot board=ESP32 baud=%d link=%s\n", PIPE_BAUD, LINK_NAME);
#if defined(ESP32)
  {
    static const char *names[] = { "unknown", "poweron", "ext", "sw", "panic", "int_wdt",
                                   "task_wdt", "wdt", "deepsleep", "brownout", "sdio" };
    esp_reset_reason_t why = esp_reset_reason();
    DBG("[bridge] reset=%s heap=%u\n",
        (why >= 0 && why <= 10) ? names[why] : "?", (unsigned)ESP.getFreeHeap());
  }
#endif
#if defined(ESP32)
  Serial2.setRxBufferSize(2048);
  Serial2.begin(PIPE_BAUD, SERIAL_8N1, PIN_STM_RX, PIN_STM_TX);
#else
  STM.setRxBufferSize(1024);
  STM.begin(PIPE_BAUD);
  STM.setDebugOutput(false);
#endif

  pinMode(s_pinBoot0, OUTPUT);
  pinMode(s_pinNrst, OUTPUT);
  boot0Set(0);
  nrstSet(1);

  WiFi.persistent(false);
#if defined(ESP32)
  WiFi.setSleep(false);                 /* modem sleep stalls TCP sessions */
#else
  WiFi.setSleepMode(WIFI_NONE_SLEEP);   /* modem sleep stalls TCP sessions on this chip */
#endif
  credsLoad();
  DBG("[bridge] creds src=%s ssid=%s passLen=%u\n", s_wifiSrc, s_creds.ssid, (unsigned)strlen(s_creds.pass));

  bool ok = false;
  if (credsValid()) {
    ok = joinWifi(s_creds.ssid, s_creds.pass, STA_TIMEOUT_MS);
    DBG("[bridge] join flash ssid=%s -> %s ip=%s\n", s_creds.ssid, ok ? "ok" : "fail", ipString().c_str());
    if (ok) s_wifiSrc = "flash";
  }
  if (!ok && strlen(WIFI_SSID) > 0) {
    ok = joinWifi(WIFI_SSID, WIFI_PASS, STA_TIMEOUT_MS);
    DBG("[bridge] join build ssid=%s -> %s ip=%s\n", WIFI_SSID, ok ? "ok" : "fail", ipString().c_str());
    if (ok) s_wifiSrc = "build";
  }
  if (!ok) startProvisioning();

  /* Both chips may have powered up together, with the STM32 stuck in its bootloader
   * because GPIO2 (BOOT0) was high while the ESP was booting. Put BOOT0 low and give
   * the STM32 one clean reset so it starts the application. */
#if SELF_SYNC_STM32
  boot0Set(0);
  delay(20);
  nrstPulse(60);
#endif

  ctrlServer.begin();
  ctrlServer.setNoDelay(true);
  pipeServer.begin();
  pipeServer.setNoDelay(true);
}

#if LINK_MODE == LINK_MODE_BLOCK || LINK_MODE == LINK_MODE_SPOOL
static bool uartAck(uint32_t ms)
{
  uint32_t deadline = millis() + ms;
  while ((int32_t)(millis() - deadline) < 0) {
    if (STM.available()) {
      uint8_t b = (uint8_t)STM.read();
      return b == 0x79;               /* ACK */
    }
    yield();
  }
  return false;
}

static void uartSend(const uint8_t *data, size_t n)
{
  STM.write(data, n);
  STM.flush();
}

#define AN3155_PAIR_GAP_MS 0     /* 实测：这块板接受连续发送（15:36 版就是这样写成功的） */
#ifndef AN3155_DATA_GAP_MS
#define AN3155_DATA_GAP_MS 0        /* 0 = 整帧连发（配合 60 s 等待先验证"是不是慢"） */
#endif

static void uartDrain(void) { while (STM.available()) STM.read(); }

static bool an3155Command(uint8_t cmd)
{
  uartDrain();                           /* 丢掉残留字节，避免把旧的 0x1F 当成这次的回复 */
  uint8_t pair[2] = { cmd, (uint8_t)(cmd ^ 0xFF) };
  uartSend(pair, 2);                     /* 一次写完，不留间隙 */
  return uartAck(5000);
}

static bool an3155Resync()
{
  while (STM.available()) STM.read();
  uint8_t sync = 0x7F;
  uartSend(&sync, 1);
  uint32_t deadline = millis() + 500;
  while ((int32_t)(millis() - deadline) < 0) {
    if (STM.available()) { (void)STM.read(); return true; }   /* ACK 或 NAK 都算同步态 */
    yield();
  }
  return false;
}

#endif

#if LINK_MODE == LINK_MODE_BLOCK
/* ── 块级 ACK：主机 "#B <addr> <len>" + 负载，ESP 自己做三段握手并重试 ── */
/* ── 块级 ACK ────────────────────────────────────────────────────────────────
 * 主机在 3334 上发 "#B <addr-hex> <len>\n" + len 字节，ESP 自己做 AN3155 的
 * 三段握手（命令 / 地址 / 数据），失败就重新同步并重试，最后回一行
 * "+B ok <tries>" 或 "+B err <tries>"。这样一块只占一次 TCP 往返。
 * ────────────────────────────────────────────────────────────────────────── */
static uint8_t  s_blk[256];
static uint32_t s_blkAddr = 0;
static uint32_t s_blkNeed = 0;
static uint32_t s_blkLen  = 0;
static char     s_line[24];
static uint8_t  s_lineLen = 0;

static bool an3155WriteBlock()
{
  uint32_t len = s_blkLen;
  if (!an3155Command(0x31)) return false;

  uint8_t head[5];
  head[0] = (uint8_t)(s_blkAddr >> 24);
  head[1] = (uint8_t)(s_blkAddr >> 16);
  head[2] = (uint8_t)(s_blkAddr >> 8);
  head[3] = (uint8_t)(s_blkAddr);
  head[4] = (uint8_t)(head[0] ^ head[1] ^ head[2] ^ head[3]);
  uartSend(head, 5);
  if (!uartAck(700)) return false;

  uint32_t padded = (len + 3u) & ~3u;              /* F4 按 32 位写，补齐到 4 字节 */
  uint8_t frame[2 + 256];
  frame[0] = (uint8_t)(len - 1u);
  uint8_t sum = frame[0];
  for (uint32_t i = 0; i < padded; i++) {
    uint8_t b = (i < len) ? s_blk[i] : 0xFF;
    frame[1 + i] = b;
    sum ^= b;
  }
  frame[1 + padded] = sum;
  uartSend(frame, padded + 2u);
  return uartAck(1200);
}

static void finishBlock(WiFiClient &client)
{
  bool ok = false;
  uint8_t tries = 0;
  for (tries = 1; tries <= 4 && !ok; tries++) {
    ok = an3155WriteBlock();
    if (!ok) an3155Resync();
  }
  char reply[24];
  snprintf(reply, sizeof reply, "+B %s %u\r\n", ok ? "ok" : "err", (unsigned) (ok ? tries - 1u : tries - 1u));
  client.write((const uint8_t *)reply, strlen(reply));
  s_blkNeed = 0;
  s_blkLen  = 0;
}
#endif


#if LINK_MODE == LINK_MODE_SPOOL
/* ── 全量缓存 ────────────────────────────────────────────────────────────────
 * 主机先把镜像塞进 ESP 的文件系统，ESP 再自己跑 AN3155（复位 → 同步 → 擦除
 * → 写 → GO）。这样 Wi-Fi 抖动完全不在烧录时序里，断网也烧不到一半。
 *
 *   #I <bytes>                       开始接收   -> +I ok <bytes> | +I err ...
 *   #S <offset> <len> + len 字节      写入片段   -> +S ok <end>    | +S err ...
 *   #F <base> <eraseCmd> <n> <s0,..> 开始烧录   -> +F <stage> ...  -> +F ok <ms>
 *   #Q                               查询状态   -> +Q <state> <bytes>
 *   #A                               放弃       -> +A ok
 * ────────────────────────────────────────────────────────────────────────── */
static const char *SPOOL_PATH = "/stm32.bin";
static uint32_t s_spoolTotal = 0;
static uint32_t s_spoolHave  = 0;
static const char *s_spoolState = "idle";
static char     s_spoolLine[64];
static uint8_t  s_spoolLineLen = 0;
/* 原始字节攒一攒再发：逐字节写会让帧内出现毫秒级间隙，bootloader 会判成坏帧 */
static uint8_t  s_raw[512];
static size_t   s_rawLen = 0;
static void rawFlush(void)
{
  if (!s_rawLen) return;
  STM.write(s_raw, s_rawLen);
  pipeBytesDown += s_rawLen;
  s_rawLen = 0;
}

/* CRC-16/CCITT-FALSE：主机与 ESP 用同一套实现，逐片校验，校验不过就重发 */
static uint16_t crc16ccitt(const uint8_t *data, uint32_t len)
{
  uint16_t crc = 0xFFFF;
  for (uint32_t i = 0; i < len; i++) {
    crc ^= (uint16_t)data[i] << 8;
    for (uint8_t bit = 0; bit < 8; bit++) {
      crc = (crc & 0x8000) ? (uint16_t)((crc << 1) ^ 0x1021) : (uint16_t)(crc << 1);
    }
  }
  return crc;
}

static uint16_t s_pendCrc = 0;
static uint32_t s_pendOff = 0;
static uint32_t s_pendNeed = 0;
static uint32_t s_pendLen = 0;
static uint8_t  s_spoolBuf[256];

static void spoolReply(WiFiClient &client, const char *fmt, ...)
{
  char buf[96];
  va_list ap;
  va_start(ap, fmt);
  vsnprintf(buf, sizeof buf, fmt, ap);
  va_end(ap);
  client.write((const uint8_t *)buf, strlen(buf));
}

static bool spoolFileOpen(uint32_t bytes)
{
  if (!s_spoolFsOk) {
#if defined(ESP32)
    s_spoolFsOk = LittleFS.begin(true);          /* format on first use */
#else
    s_spoolFsOk = LittleFS.begin();
#endif
    DBG("[bridge] littlefs %s\n", s_spoolFsOk ? "mounted" : "FAILED");
  }
  if (!s_spoolFsOk) return false;
  LittleFS.remove(SPOOL_PATH);
  File f = LittleFS.open(SPOOL_PATH, "w");
  if (!f) return false;
  f.close();
  s_spoolTotal = bytes;
  s_spoolHave  = 0;
  return true;
}

static bool spoolStore(uint32_t offset, const uint8_t *data, uint32_t len)
{
  File f = LittleFS.open(SPOOL_PATH, "r+");
  if (!f) return false;
  if (!f.seek(offset)) { f.close(); return false; }
  size_t written = f.write(data, len);
  f.close();
  if (written != len) return false;
  if (offset + len > s_spoolHave) s_spoolHave = offset + len;
  return true;
}

static bool an3155SyncStrict(uint8_t tries)
{
  for (uint8_t i = 0; i < tries; i++) {
    while (STM.available()) STM.read();
    uint8_t sync = 0x7F;
    uartSend(&sync, 1);
    uint32_t deadline = millis() + 300;
    while ((int32_t)(millis() - deadline) < 0) {
      if (STM.available()) {
        uint8_t b = (uint8_t)STM.read();
        if (b == 0x79) return true;        /* 只有 ACK 才算同步成功；0x1F 说明芯片退回了等待态 */
        return false;
      }
      yield();
    }
  }
  return false;
}

static const char *s_eraseWhy = "";

static bool an3155Erase(uint8_t eraseCmd, uint8_t count, const uint8_t *lo, const uint8_t *hi)
{
  uartDrain();
  uint8_t pair[2] = { eraseCmd, (uint8_t)(eraseCmd ^ 0xFF) };
  uartSend(pair, 2);
  if (!uartAck(5000)) { s_eraseWhy = "cmd"; return false; }

  uint8_t frame[1 + 2 * 32 + 1];
  uint32_t p = 0;
  uint8_t sum = 0;
  uint8_t n = (count == 0) ? 0 : (uint8_t)(count - 1);        /* AN3155: N = 个数-1 */
  if (eraseCmd == 0x44) {
    frame[p++] = 0x00; sum ^= 0x00;
    frame[p++] = n;    sum ^= n;
    for (uint8_t i = 0; i < count; i++) {
      frame[p++] = 0x00; sum ^= 0x00;
      frame[p++] = lo[i]; sum ^= lo[i];
    }
  } else {
    frame[p++] = n;    sum ^= n;
    for (uint8_t i = 0; i < count; i++) { frame[p++] = hi[i]; sum ^= hi[i]; }
  }
  frame[p++] = sum;
  uartSend(frame, p);
  bool ok = uartAck(45000);                                    /* 擦除可能很慢 */
  if (!ok) s_eraseWhy = "payload";
  return ok;
}

static const char *s_writeWhy = "";

static bool an3155WriteAt(uint32_t addr, const uint8_t *data, uint32_t len)
{
  if (!an3155Command(0x31)) { s_writeWhy = "cmd"; return false; }
  uint8_t head[5];
  head[0] = (uint8_t)(addr >> 24); head[1] = (uint8_t)(addr >> 16);
  head[2] = (uint8_t)(addr >> 8);  head[3] = (uint8_t)addr;
  head[4] = (uint8_t)(head[0] ^ head[1] ^ head[2] ^ head[3]);
  uartSend(head, 5);
  if (!uartAck(5000)) { s_writeWhy = "addr"; return false; }

  uint32_t padded = (len + 3u) & ~3u;
  static uint8_t frame[2 + 256];
  frame[0] = (uint8_t)(len - 1u);
  uint8_t sum = frame[0];
  for (uint32_t i = 0; i < padded; i++) {
    uint8_t b = (i < len) ? data[i] : 0xFF;
    frame[1 + i] = b;
    sum ^= b;
  }
  frame[1 + padded] = sum;
  if (AN3155_DATA_GAP_MS > 0) {                                /* 数据帧逐字节 + 间隙 */
    for (uint32_t i = 0; i < padded + 2u; i++) {
      uartSend(&frame[i], 1);
      delay(AN3155_DATA_GAP_MS);
    }
  } else {
    uartSend(frame, padded + 2u);
  }
  bool dataOk = uartAck(60000);          /* 万一只是慢：等满 1 分钟 */
  if (!dataOk) s_writeWhy = "data";
  return dataOk;
}

static bool an3155Go(uint32_t addr)
{
  if (!an3155Command(0x21)) return false;
  uint8_t head[5];
  head[0] = (uint8_t)(addr >> 24); head[1] = (uint8_t)(addr >> 16);
  head[2] = (uint8_t)(addr >> 8);  head[3] = (uint8_t)addr;
  head[4] = (uint8_t)(head[0] ^ head[1] ^ head[2] ^ head[3]);
  uartSend(head, 5);
  return uartAck(2000);
}

static bool spoolRunFlash(WiFiClient &client, uint32_t base, uint8_t eraseCmd,
                          uint8_t count, const uint8_t *lo, const uint8_t *hi)
{
  s_spoolState = "flashing";
  spoolReply(client, "+F reset\r\n");
  boot0Set(1);
  delay(BOOT_SETTLE_MS);
  nrstPulse(RESET_PULSE_MS);
  delay(BOOT_POST_MS);

  bool synced = false;
  for (uint8_t round = 1; round <= 3 && !synced; round++) {
    synced = an3155SyncStrict(40);
    if (!synced) {
      spoolReply(client, "+F retry sync %u\r\n", (unsigned)round);
      boot0Set(1);
      delay(BOOT_SETTLE_MS);
      nrstPulse(RESET_PULSE_MS);
      delay(BOOT_POST_MS);
    }
  }
  if (!synced) {
    spoolReply(client, "+F err nosync\r\n");
    s_spoolState = "error";
    boot0Set(0);
    return false;
  }
  spoolReply(client, "+F sync ok\r\n");

  bool erased = false;
  for (uint8_t round = 1; round <= 5 && !erased; round++) {
    erased = an3155Erase(eraseCmd, count, lo, hi);
    if (!erased) {
      spoolReply(client, "+F retry erase %u (%s)\r\n", (unsigned)round, s_eraseWhy);
      (void)an3155SyncStrict(20);          /* 芯片只认 0x7F：拉回同步态再试 */
      delay(20);
    }
  }
  if (!erased) {
    spoolReply(client, "+F err erase %s\r\n", s_eraseWhy);
    s_spoolState = "error";
    boot0Set(0);
    return false;
  }
  spoolReply(client, "+F erase ok\r\n");

  File f = LittleFS.open(SPOOL_PATH, "r");
  if (!f) {
    spoolReply(client, "+F err nofile\r\n");
    s_spoolState = "error";
    boot0Set(0);
    return false;
  }

  static uint8_t blk[256];
  uint32_t total = s_spoolHave;
  uint32_t done = 0;
  uint32_t t0 = millis();
  while (done < total) {
    size_t n = f.read(blk, sizeof blk);
    if (!n) break;
    bool ok = false;
    for (uint8_t tries = 0; tries < 4 && !ok; tries++) {
      ok = an3155WriteAt(base + done, blk, (uint32_t)n);
      if (!ok) { an3155Resync(); (void)an3155SyncStrict(6); }
    }
    if (!ok) {
      f.close();
      spoolReply(client, "+F err write 0x%lx %s\r\n", (unsigned long)(base + done), s_writeWhy);
      s_spoolState = "error";
      boot0Set(0);
      return false;
    }
    done += (uint32_t)n;
    if ((done % 4096u) == 0u || done >= total) {
      spoolReply(client, "+F write %lu %lu\r\n", (unsigned long)done, (unsigned long)total);
    }
    yield();
  }
  f.close();

  (void)an3155Go(base);                       /* 失败也无所谓：复位后照样运行 */
  boot0Set(0);
  nrstPulse(RESET_PULSE_MS);
  spoolReply(client, "+F ok %lu\r\n", (unsigned long)(millis() - t0));
  s_spoolState = "done";
  return true;
}
#endif


void loop()
{
  if (s_provisioning) {
    dns.processNextRequest();
    web.handleClient();
    if (WiFi.getMode() == WIFI_STA) s_provisioning = false;   /* saved + rebooted */
  }

  if (ctrlClient && !ctrlClient.connected()) {
    ctrlClient.stop();
  }
  if (!ctrlClient || !ctrlClient.connected()) {
    WiFiClient fresh = ctrlServer.available();
    if (fresh) {
      ctrlClient = fresh;
      ctrlClient.setNoDelay(true);
      banner();
    }
  }
  if (pipeClient && !pipeClient.connected()) {
    pipeClient.stop();
  }
  if (!pipeClient || !pipeClient.connected()) {
    WiFiClient fresh = pipeServer.available();
    if (fresh) {
      pipeClient = fresh;
      pipeClient.setNoDelay(true);
      while (STM.available()) STM.read();
    }
  }

  if (ctrlClient && ctrlClient.connected()) {
    while (ctrlClient.available()) {
      String line = ctrlClient.readStringUntil('\n');
      handleCommand(line);
    }
  }

  if (pipeClient && pipeClient.connected()) {
    uint8_t buf[128];
    size_t n = 0;
#if LINK_MODE == LINK_MODE_SPOOL
    while (pipeClient.available()) {
      uint8_t ch = (uint8_t)pipeClient.read();
      if (s_pendNeed) {                        /* "#S" 的负载：攒够再落盘 */
        if (s_pendLen < sizeof s_spoolBuf) s_spoolBuf[s_pendLen++] = ch;
        if (s_pendLen >= s_pendNeed) {
          uint16_t crcGot = crc16ccitt(s_spoolBuf, s_pendLen);
          if (crcGot != s_pendCrc) {
            spoolReply(pipeClient, "+S err crc %04x\r\n", crcGot);   /* 主机重发这一片 */
          } else if (spoolStore(s_pendOff, s_spoolBuf, s_pendLen)) {
            spoolReply(pipeClient, "+S ok %lu\r\n", (unsigned long)(s_pendOff + s_pendLen));
          } else {
            spoolReply(pipeClient, "+S err disk\r\n");
          }
          s_pendNeed = 0;
          s_pendLen = 0;
        }
        continue;
      }
      if (s_spoolLineLen || ch == '#') {
        rawFlush();
        if (s_spoolLineLen < sizeof s_spoolLine - 1) s_spoolLine[s_spoolLineLen++] = (char)ch;
        if (ch == '\n') {
          s_spoolLine[s_spoolLineLen] = 0;
          unsigned long a = 0, b = 0, c = 0;
          if (s_spoolLine[1] == 'I') {
            s_pendNeed = 0; s_pendLen = 0;
            if (sscanf(s_spoolLine, "#I %lu", &a) == 1 && a > 0 && spoolFileOpen((uint32_t)a)) {
              spoolReply(pipeClient, "+I ok %lu\r\n", a);
              s_spoolState = "uploading";
            } else {
              spoolReply(pipeClient, "+I err %s\r\n", s_spoolFsOk ? "frame" : "nofs");
            }
          } else if (s_spoolLine[1] == 'S') {
            unsigned int crcIn = 0;
            if (sscanf(s_spoolLine, "#S %lx %lu %x", &a, &b, &crcIn) == 3 && b > 0 && b <= sizeof s_spoolBuf &&
                s_spoolTotal > 0 && a + b <= s_spoolTotal) {
              s_pendCrc = (uint16_t)crcIn;
              s_pendOff = (uint32_t)a;
              s_pendNeed = (uint32_t)b;
              s_pendLen = 0;
              /* 先回执，主机收到后再发数据：彻底消除"命令与负载错位"的可能 */
              spoolReply(pipeClient, "+S begin %lu\r\n", (unsigned long)a);
            } else {
              spoolReply(pipeClient, "+S err frame\r\n");
            }
          } else if (s_spoolLine[1] == 'Z') {
            /* #Z <crc16>：整张镜像校验，通过才允许 #F */
            unsigned int want = 0;
            File zf = LittleFS.open(SPOOL_PATH, "r");
            const bool zOpened = (bool)zf;
            uint16_t got = 0xFFFF;
            if (zOpened) {
              static uint8_t zbuf[256];
              size_t zn = 0;
              while ((zn = zf.read(zbuf, sizeof zbuf)) > 0) {
                for (size_t i = 0; i < zn; i++) {
                  got ^= (uint16_t)zbuf[i] << 8;
                  for (uint8_t bit = 0; bit < 8; bit++) got = (got & 0x8000) ? (uint16_t)((got << 1) ^ 0x1021) : (uint16_t)(got << 1);
                }
              }
              zf.close();
            }
            if (sscanf(s_spoolLine, "#Z %x", &want) == 1 && zOpened) {
              spoolReply(pipeClient, "+Z %s %04x %lu\r\n", (got == (uint16_t)want) ? "ok" : "err", got, (unsigned long)s_spoolHave);
            } else {
              spoolReply(pipeClient, "+Z err nofile\r\n");
            }
          } else if (s_spoolLine[1] == 'F') {
            /* #F <base> <eraseCmd> <n> <s0,s1,...> */
            char list[80] = "";
            unsigned long cmd = 0, cnt = 0;
            if (sscanf(s_spoolLine, "#F %lx %lx %lu %79s", &a, &cmd, &cnt, list) >= 3 &&
                cnt >= 1 && cnt <= 32) {
              uint8_t lo[32], hi[32];
              char *tok = strtok(list, ",");
              uint8_t i = 0;
              while (tok && i < cnt) {
                unsigned long v = strtoul(tok, 0, 10);
                lo[i] = (uint8_t)(v & 0xFF);
                hi[i] = (uint8_t)(v & 0xFF);
                i++;
                tok = strtok(0, ",");
              }
              if (i == cnt) {
                spoolRunFlash(pipeClient, (uint32_t)a, (uint8_t)cmd, (uint8_t)cnt, lo, hi);
              } else {
                spoolReply(pipeClient, "+F err sectors\r\n");
              }
            } else {
              spoolReply(pipeClient, "+F err frame\r\n");
            }
          } else if (s_spoolLine[1] == 'Q') {
            spoolReply(pipeClient, "+Q %s %lu\r\n", s_spoolState, (unsigned long)s_spoolHave);
          } else if (s_spoolLine[1] == 'A') {
            s_pendNeed = 0; s_pendLen = 0; s_spoolHave = 0; s_spoolTotal = 0;
            s_spoolState = "idle";
            spoolReply(pipeClient, "+A ok\r\n");
          } else {
            spoolReply(pipeClient, "+E bad\r\n");
          }
          s_spoolLineLen = 0;
        }
        continue;
      }
      if (s_rawLen >= sizeof s_raw) rawFlush();
      s_raw[s_rawLen++] = ch;                  /* 非命令字节：攒起来成批发 */
    }
    rawFlush();
#elif LINK_MODE == LINK_MODE_BLOCK
    /* 块级 ACK：二进制负载按 "#B" 声明的长度直接吞下，不会把负载里的 '#' 当命令 */
    while (pipeClient.available()) {
      uint8_t ch = (uint8_t)pipeClient.read();
      if (s_blkNeed) {
        if (s_blkLen < sizeof s_blk) s_blk[s_blkLen++] = ch;
        if (s_blkLen >= s_blkNeed) finishBlock(pipeClient);
        continue;
      }
      if (s_lineLen || ch == '#') {
        if (s_lineLen < sizeof s_line - 1) s_line[s_lineLen++] = (char)ch;
        /* 只有 "#B" 才是命令：AN3155 的普通字节里 0x23 也可能是数据，不能误吞 */
        if (s_lineLen == 2 && !(s_line[0] == '#' && s_line[1] == 'B')) {
          if (s_rawLen + s_lineLen > sizeof s_raw) rawFlush();
          memcpy(s_raw + s_rawLen, s_line, s_lineLen);
          s_rawLen += s_lineLen;
          s_lineLen = 0;
          rawFlush();
          continue;
        }
        if (ch == '\n') {
          s_line[s_lineLen] = 0;
          unsigned long addr = 0, len = 0;
          if (sscanf(s_line, "#B %lx %lu", &addr, &len) == 2 && len >= 1 && len <= sizeof s_blk) {
            s_blkAddr = (uint32_t)addr;
            s_blkNeed = (uint32_t)len;
            s_blkLen  = 0;
          } else {
            const char *bad = "+B bad\r\n";
            pipeClient.write((const uint8_t *)bad, strlen(bad));
          }
          s_lineLen = 0;
        }
        continue;
      }
      STM.write(ch);
      pipeBytesDown += 1;
    }
#else
    while (pipeClient.available() && n < sizeof(buf)) buf[n++] = (uint8_t)pipeClient.read();
    if (n > 0) {
      STM.write(buf, n);
      STM.flush();
      pipeBytesDown += n;
    }
#endif
    n = 0;
    while (STM.available() && n < sizeof(buf)) buf[n++] = (uint8_t)STM.read();
    if (n > 0) {
      pipeClient.write(buf, n);
      pipeBytesUp += n;
    }
  }
  yield();
}
